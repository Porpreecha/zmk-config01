/ {
    chosen {
        zmk,kscan = &kscan0;
    };
};

&kscan0 {
    col-gpios = <&gpio0 2 (GPIO_ACTIVE_LOW | GPIO_PULL_UP)>,
                <&gpio0 3 (GPIO_ACTIVE_LOW | GPIO_PULL_UP)>;
    row-gpios = <&gpio0 4 (GPIO_ACTIVE_LOW | GPIO_PULL_UP)>,
                <&gpio0 5 (GPIO_ACTIVE_LOW | GPIO_PULL_UP)>;
};
